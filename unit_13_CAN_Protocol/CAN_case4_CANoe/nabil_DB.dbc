VERSION ""

NS_ :

BS_:

BU_: ECU2_Speed_Control ECU1_ACC_Control

BO_ 939 Speed_Val_Msg: 1 ECU2_Speed_Control
 SG_ Speed_Value : 0|8@1+ (1,0) [0|220] ""  ECU1_ACC_Control

BO_ 48 ACC_Ctrl_Msg: 1 ECU1_ACC_Control
 SG_ ACC_Command : 0|8@1+ (1,0) [0|1] ""  ECU2_Speed_Control
